/*
 * Tempest Dux right half = peripheral.
 */

#include "tempest_dux.dtsi"

// Shift this half's columns into the 5-9 block of the transform.
&default_transform {
    col-offset = <5>;
};

// Forward the local trackball to the central over the split link.
&trackball_split {
    device = <&trackball>;
};
