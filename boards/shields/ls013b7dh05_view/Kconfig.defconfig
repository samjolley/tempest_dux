## boards/shields/ls013b7dh05_view/Kconfig.shield
```kconfig
config SHIELD_LS013B7DH05_VIEW
    def_bool $(shields_list_contains,ls013b7dh05_view)
```

## boards/shields/tempest_dux/Kconfig.shield
```kconfig
config SHIELD_TEMPEST_DUX_LEFT
    def_bool $(shields_list_contains,tempest_dux_left)

config SHIELD_TEMPEST_DUX_RIGHT
    def_bool $(shields_list_contains,tempest_dux_right)
```
