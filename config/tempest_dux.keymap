// Tempest_Dux Keymap
// Based on samjolley/miryoku_zmk (Rae_Dux Rebase-2026)

#include <behaviors.dtsi>
#include <dt-bindings/zmk/keys.h>
#include <dt-bindings/zmk/bt.h>
#include <dt-bindings/zmk/pointing.h>

// Miryoku Core Logic
#include "miryoku/custom_config.h"
#include "miryoku/mapping/36/minidox.h"
#include "miryoku/miryoku.dtsi"
#include "miryoku/combos.dtsi"

/ {
    /* 
     * Trackball specific behaviors or layer taps go here 
     * e.g. &lt MOUSE_LAYER Ball_Click 
     */
};
