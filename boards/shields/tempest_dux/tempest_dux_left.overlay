/*
 * Tempest Dux left half = central + display side.
 * The display comes from shield composition
 * ("tempest_dux_left nice_view_adapter ls013b7dh05_view"); nothing needed here.
 */

#include "tempest_dux.dtsi"

// Local (left) trackball feeds the pointer directly.
&trackball_listener {
    status = "okay";
};

// Right half's trackball arrives over the split link.
&trackball_split_listener {
    status = "okay";
};
